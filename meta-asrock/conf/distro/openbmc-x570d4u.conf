## meta-asrock/conf/machine/x570d4u.conf
```bitbake
KMACHINE = "aspeed"
KERNEL_DEVICETREE = "${KMACHINE}-bmc-opp-${MACHINE}.dtb"

UBOOT_MACHINE = "ast_g5_ncsi_config"

require conf/machine/include/ast2500.inc
require conf/machine/include/obmc-bsp-common.inc

# Inhibit phosphor-hwmon-config-mrw
VIRTUAL-RUNTIME_phosphor-hwmon-config_df-mrw = ""

# Inhibit phosphor-fan-presence-mrw-native
PREFERRED_PROVIDER_virtual/phosphor-fan-presence-config_df-mrw = \
    "phosphor-fan-presence-config"

# Inhibit phosphor-fan-control-fan-config-mrw-native
PREFERRED_PROVIDER_virtual/phosphor-fan-control-fan-config_df-mrw = \
    "phosphor-fan-control-fan-config"

KERNEL_FEATURES_remove = "phosphor-gpio-keys"
KERNEL_FEATURES_remove = "phosphor-vlan"

FLASH_SIZE = "65536"
```

## meta-asrock/meta-x570d4u/conf/machine/x570d4u.conf
```bitbake
KMACHINE = "aspeed"
KERNEL_DEVICETREE = "${KMACHINE}/${KMACHINE}-bmc-asrock-${MACHINE}.dtb"

FLASH_SIZE = "65536"

PREFERRED_PROVIDER_virtual/bootloader = "u-boot-aspeed"
PREFERRED_PROVIDER_u-boot = "u-boot-aspeed"
PREFERRED_PROVIDER_u-boot-fw-utils = "u-boot-fw-utils-aspeed"
UBOOT_MACHINE = "ast_g5_ncsi_config"

#UBOOT_MACHINE = "evb-ast2500_defconfig"
#UBOOT_DEVICETREE = "ast2500-evb"

require conf/machine/include/ast2500.inc
require conf/machine/include/obmc-bsp-common.inc

VIRTUAL-RUNTIME_obmc-inventory-manager = "entity-manager"
VIRTUAL-RUNTIME_obmc-sensors-hwmon = "dbus-sensors"

PREFERRED_PROVIDER_virtual/obmc-flash-mgmt = "packagegroup-asrock-apps"
PREFERRED_PROVIDER_virtual/obmc-system-mgmt = "packagegroup-asrock-apps"

VIRTUAL-RUNTIME_obmc-host-state-manager = "x86-power-control"
VIRTUAL-RUNTIME_obmc-chassis-state-manager = "x86-power-control"
```

## meta-ibm/conf/distro/openbmc-witherspoon.conf
```bitbake
require conf/distro/openbmc-openpower.conf
require conf/distro/include/phosphor-ubi-df.inc
require conf/distro/include/openpower-mrw.inc
require conf/distro/include/openpower-ubi.inc
```

## meta-phosphor/conf/distro/include/phosphor-ubi-df.inc
```bitbake
DISTRO_FEATURES += "obmc-ubi-fs"
DISTROOVERRIDES .= ":obmc-ubi-fs:df-obmc-ubi-fs"
```
